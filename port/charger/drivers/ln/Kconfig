## port/pinctrl/Kconfig.fragment
```kconfig
config PINCTRL_MT6877
	tristate "Mediatek MT6877 pin control"
	depends on OF || COMPILE_TEST
	select PINCTRL_MTK_PARIS
	help
	  This is the pin controller and gpio driver for mediatek
	  mt6877 chipset. It enables the MediaTek common v2, paris
	  and eint core drivers.
	  Say Y here to enable it.
```

## port/touch/focaltech_3680/Kconfig
```kconfig
#
# Focaltech FT3680 (SPI) para ruby
#

config TOUCHSCREEN_FOCALTECH_3680
    tristate "Focaltech FT3680 touchscreen (SPI)"
    help
      Driver del panel tactil Focaltech FT3680 que monta el
      Xiaomi ruby (m16) sobre SPI3.
```
